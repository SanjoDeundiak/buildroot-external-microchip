## package/ockam/ockamd/Config.in
```kconfig
config BR2_PACKAGE_OCKAMD
        bool "ockamd"
        help
          Ockamd explanaition goes here

          http://github.com/ockam-network/ockam
```

## package/ockamd/Config.in
```kconfig
config BR2_PACKAGE_OCKAMD
        bool "ockamd"
        depends on BR2_PACKAGE_HOST_RUSTC_TARGET_ARCH_SUPPORTS
        depends on BR2_PACKAGE_HOST_CARGO
        select BR2_PACKAGE_HOST_RUSTC
        help
          Ockamd explanaition goes here

          http://github.com/ockam-network/ockam
```
